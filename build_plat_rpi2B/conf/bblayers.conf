## build_plat_rpi2B/conf/bblayers.conf
```bitbake
# LAYER_CONF_VERSION is increased each time build/conf/bblayers.conf
# changes incompatibly
LCONF_VERSION = "8"

BBPATH = "${TOPDIR}"
BBFILES ?= ""

BBLAYERS ?= " \
  /home/openbmc/embedded_Adam/Study/obmc/meta \
  /home/openbmc/embedded_Adam/Study/obmc/meta-openembedded/meta-oe \
  /home/openbmc/embedded_Adam/Study/obmc/meta-openembedded/meta-networking \
  /home/openbmc/embedded_Adam/Study/obmc/meta-openembedded/meta-python \
  /home/openbmc/embedded_Adam/Study/obmc/meta-phosphor \
  /home/openbmc/embedded_Adam/Study/obmc/meta-abc/meta-common \
  /home/openbmc/embedded_Adam/Study/obmc/meta-abc/meta-plat_rpi2B \
  "
```

## obmc/meta-abc/meta-common/conf/distro/abc.conf
```bitbake
require conf/distro/abc-pre.conf
require conf/distro/openbmc-phosphor.conf
require conf/distro/abc-post.conf
```

## obmc/meta-abc/meta-common/conf/machine/include/abc-base.inc
```bitbake
include conf/machine/include/soc-family.inc

PREFERRED_PROVIDER_virtual/kernel ?= "linux-abc"
PREFERRED_PROVIDER_virtual/bootloader ?= "u-boot"

KERNEL_IMAGETYPE ?= "fitImage"
KERNEL_CLASSES ?= "kernel-fitimage"
INITRAMFS_FSTYPES ?= "cpio.xz"

#FLASH_SIZE = "32768"
FLASH_SIZE = "65536"
#FLASH_SIZE = "131072"

# Disable hardware root of trust by default.
# If users want to enable secure boot,
# please do the following steps.
# 1. Set SOCSEC_SIGN_ENABLE to “1”.
# 2. Provide platform OTP config.
# There was an example in p10bmc.
# If users enable socsec signing but do not provide OTP config,
# u-boot will be built failed.
SOCSEC_SIGN_ENABLE = "0"

#MACHINE_FEATURES += "obmc-bmc-state-mgmt"
#MACHINE_FEATURES += "obmc-chassis-state-mgmt"
MACHINE_FEATURES += "obmc-host-ipmi"
#MACHINE_FEATURES += "obmc-host-state-mgmt"
#MACHINE_FEATURES += "obmc-phosphor-chassis-mgmt"
#MACHINE_FEATURES += "obmc-phosphor-flash-mgmt"
#MACHINE_FEATURES += "obmc-phosphor-fan-mgmt"

# PREFERRED_PROVIDER_virtual/obmc-chassis-mgmt = "packagegroup-test-apps"
# PREFERRED_PROVIDER_virtual/obmc-system-mgmt = "packagegroup-test-apps"
# PREFERRED_PROVIDER_virtual/obmc-flash-mgmt = "packagegroup-test-apps"
PREFERRED_PROVIDER_virtual/obmc-host-ipmi-hw = "phosphor-ipmi-ssif"
# PREFERRED_PROVIDER_virtual/obmc-fan-mgmt = "packagegroup-test-apps"

VIRTUAL-RUNTIME_obmc-sensors-hwmon ?= "dbus-sensors"
```

## obmc/meta-abc/meta-plat_ast2600/conf/machine/include/ast2600.inc
```bitbake
DEFAULTTUNE ?= "armv7ahf-vfpv4d16"

include conf/machine/include/abc-base.inc
include conf/machine/include/arm/arch-armv7a.inc


# MACHINE_EXTRA_RRECOMMENDS += "udev-aspeed-vuart udev-aspeed-mtd-partitions"
MACHINE_FEATURES += "hw-rng"


SERIAL_CONSOLES ?= "115200;ttyS4"

DEFAULTTUNE ?= "armv7ahf-vfpv4d16"

UBOOT_ENTRYPOINT ?= "0x80001000"
UBOOT_LOADADDRESS ?= "0x80001000"
```

## obmc/meta-abc/meta-plat_ast2600/conf/machine/plat_ast2600.conf
```bitbake
KERNEL_DEVICETREE = "aspeed/aspeed-ast2600-evb.dtb"

UBOOT_MACHINE = "evb-ast2600_defconfig"
#UBOOT_MACHINE = "ast2600_openbmc_spl_defconfig"
UBOOT_DEVICETREE = "ast2600-evb"
SPL_BINARY = "spl/u-boot-spl.bin"

require conf/machine/include/ast2600.inc
require conf/machine/include/obmc-bsp-common.inc
```

## obmc/meta-abc/meta-plat_rpi1B/conf/layer.conf
```bitbake
# We have a conf and classes directory, add to BBPATH
BBPATH .= ":${LAYERDIR}"

# We have recipes-* directories, add to BBFILES
BBFILES += "${LAYERDIR}/recipes-*/*/*.bb \
            ${LAYERDIR}/recipes-*/*/*.bbappend"

BBFILE_COLLECTIONS += "plat_rpi1B-layer"
BBFILE_PATTERN_plat_rpi1B-layer := "^${LAYERDIR}/"
LAYERSERIES_COMPAT_plat_rpi1B-layer = "langdale mickledore"
```

## obmc/meta-abc/meta-plat_rpi1a/conf/layer.conf
```bitbake
# We have a conf and classes directory, add to BBPATH
BBPATH .= ":${LAYERDIR}"

# We have recipes-* directories, add to BBFILES
BBFILES += "${LAYERDIR}/recipes-*/*/*.bb \
            ${LAYERDIR}/recipes-*/*/*.bbappend"

LICENSE_PATH += "${LAYERDIR}/licenses"

BBFILE_COLLECTIONS += "plat_rpi1a-layer"
BBFILE_PATTERN_plat_rpi1a-layer := "^${LAYERDIR}/"
LAYERSERIES_COMPAT_plat_rpi1a-layer = "walnascar scarthgap"
```

## obmc/meta-abc/meta-plat_rpi1a/conf/machine/plat_rpi1a.conf
```bitbake
KERNEL_DEVICETREE = "broadcom/bcm2835-rpi-a.dtb"

UBOOT_MACHINE = "rpi_config"
#UBOOT_DEVICETREE = "bcm2835-rpi-a"
UBOOT_ENTRYPOINT = "0x00008000"

require conf/machine/include/rpi1-base.inc
require conf/machine/include/obmc-bsp-common.inc
```

## obmc/meta-abc/meta-plat_rpi1a/meta-prj_pmc/conf/machine/prj_rpi1a_pmc.conf
```bitbake
#KBUILD_DEFCONFIG = "bcm2835_defconfig"
KERNEL_DEVICETREE = "broadcom/bcm2835-rpi-a.dtb"

UBOOT_MACHINE = "rpi_config"
#UBOOT_DEVICETREE = "bcm2835-rpi-a"
UBOOT_ENTRYPOINT = "0x00008000"

require conf/machine/include/rpi1-base.inc
require conf/machine/include/obmc-bsp-common.inc

IMAGE_CLASSES:append = " scp-images"
SCP_IMAGE_POSTFIX = "rpi1a"

OBMC_POWER_SUPPLY_INSTANCES = "1 2 3 4"

#FLASH_ROFS_OFFSET:flash-65536 ?= "17408"
```

## obmc/meta-abc/meta-plat_rpi2B/conf/machine/include/rpi2-base.inc
```bitbake
DEFAULTTUNE ?= "armv7ve-neon"

include conf/machine/include/soc-family.inc
include conf/machine/include/arm/arch-armv7ve.inc

TUNEVALID[arm1176jzfs] = "Enable arm1176jzfs specific processor optimizations"
TUNE_CCARGS .= "${@bb.utils.contains('TUNE_FEATURES', 'arm1176jzfs', ' -mcpu=arm1176jzf-s', '', d)}"
MACHINEOVERRIDES =. "${@bb.utils.contains('TUNE_FEATURES', 'arm1176jzfs', 'armv6:', '', d)}"

AVAILTUNES += "armv7ve-neon"
ARMPKGARCH:tune-armv7ve-neon = "armv7ve"
TUNE_FEATURES:tune-armv7ve-neon = "arm armv7ve vfp neon"
PACKAGE_EXTRA_ARCHS:tune-armv7ve-neon = "armv7ve armv7ve-neon"

# Kernel and bootloader
PREFERRED_PROVIDER_virtual/kernel ?= "linux-rpi2"
PREFERRED_PROVIDER_virtual/bootloader = "u-boot"

KERNEL_IMAGETYPE ?= "fitImage"
KERNEL_CLASSES ?= "kernel-fitimage"
INITRAMFS_IMAGE ?= "aspeed-image-initramfs"
INITRAMFS_FSTYPES ?= "cpio.xz"
```

## obmc/meta-abc/meta-plat_rpi2B/conf/machine/plat_rpi2B.conf
```bitbake
KERNEL_DEVICETREE = "broadcom/bcm2836-rpi-2-b.dtb"

UBOOT_MACHINE = "rpi_2_config"
UBOOT_DEVICETREE = "bcm2709-rpi-2-b"

# Disable hardware root of trust by default.
# If users want to enable secure boot,
# please do the following steps.
# 1. Set SOCSEC_SIGN_ENABLE to “1”.
# 2. Provide platform OTP config.
# There was an example in p10bmc.
# If users enable socsec signing but do not provide OTP config,
# u-boot will be built failed.
SOCSEC_SIGN_ENABLE = "0"

require conf/machine/include/rpi2-base.inc
require conf/machine/include/obmc-bsp-common.inc

#FLASH_SIZE = "32768"
FLASH_SIZE = "65536"
```

## obmc/meta-abc/meta-plat_rpi2b/conf/layer.conf
```bitbake
# We have a conf and classes directory, add to BBPATH
BBPATH .= ":${LAYERDIR}"

# We have recipes-* directories, add to BBFILES
BBFILES += "${LAYERDIR}/recipes-*/*/*.bb \
            ${LAYERDIR}/recipes-*/*/*.bbappend"

BBFILE_COLLECTIONS += "plat_rpi2b-layer"
BBFILE_PATTERN_plat_rpi2b-layer := "^${LAYERDIR}/"
LAYERSERIES_COMPAT_plat_rpi2b-layer = "langdale mickledore"
```

## obmc/meta-abc/meta-plat_rpi2b/conf/machine/include/rpi2-base.inc
```bitbake
DEFAULTTUNE ?= "cortexa7thf-neon-vfpv4"

include conf/machine/include/abc-base.inc
include conf/machine/include/arm/armv7a/tune-cortexa7.inc

SERIAL_CONSOLES ?= "115200;ttyAMA0"
```

## obmc/meta-abc/meta-plat_rpi2b/conf/machine/plat_rpi2b.conf
```bitbake
KERNEL_DEVICETREE = "broadcom/bcm2836-rpi-2-b.dtb"

UBOOT_MACHINE = "rpi_2_config"
#UBOOT_DEVICETREE = "bcm2835-rpi-a"

require conf/machine/include/rpi2-base.inc
require conf/machine/include/obmc-bsp-common.inc
```

## obmc/meta-abc/meta-plat_rpi2b/meta-prj_pmc/conf/layer.conf
```bitbake
# We have a conf and classes directory, add to BBPATH
BBPATH .= ":${LAYERDIR}"

# We have recipes-* directories, add to BBFILES
BBFILES += "${LAYERDIR}/recipes-*/*/*.bb \
            ${LAYERDIR}/recipes-*/*/*.bbappend"

BBFILE_COLLECTIONS += "prj_pmc-layer"
BBFILE_PATTERN_prj_pmc-layer := "^${LAYERDIR}/"
LAYERSERIES_COMPAT_prj_pmc-layer = "walnascar scarthgap"
```

## obmc/meta-abc/meta-plat_rpi2b/meta-prj_pmc/conf/machine/prj_rpi2b_pmc.conf
```bitbake
KERNEL_DEVICETREE = "broadcom/bcm2835-rpi-a.dtb"

UBOOT_MACHINE = "rpi_config"
#UBOOT_DEVICETREE = "bcm2835-rpi-a"

require conf/machine/include/rpi2-base.inc
require conf/machine/include/obmc-bsp-common.inc

IMAGE_CLASSES:append = " scp-images"

OBMC_POWER_SUPPLY_INSTANCES = "1 2 3 4"
```

## obmc/meta-abc/meta-plat_rpi4b/conf/layer.conf
```bitbake
# We have a conf and classes directory, add to BBPATH
BBPATH .= ":${LAYERDIR}"

# We have recipes-* directories, add to BBFILES
BBFILES += "${LAYERDIR}/recipes-*/*/*.bb \
            ${LAYERDIR}/recipes-*/*/*.bbappend"

LICENSE_PATH += "${LAYERDIR}/licenses"

BBFILE_COLLECTIONS += "plat_rpi4b-layer"
BBFILE_PATTERN_plat_rpi4b-layer := "^${LAYERDIR}/"
LAYERSERIES_COMPAT_plat_rpi4b-layer = "walnascar scarthgap"
```

## obmc/meta-abc/meta-plat_rpi4b/conf/machine/include/rpi-base.inc
```bitbake
DEFAULTTUNE = "aarch64"
ARMSTUB ?= "armstub8-gic.bin"

include conf/machine/include/abc-base.inc
require conf/machine/include/arm/armv8a/tune-cortexa72.inc

SERIAL_CONSOLES ?= "115200;ttyS0"
```

## obmc/meta-abc/meta-plat_rpi4b/conf/machine/plat_rpi4b.conf
```bitbake
KERNEL_DEVICETREE = "broadcom/bcm2711-rpi-4-b.dtb"

UBOOT_MACHINE = "rpi_4_defconfig"
#UBOOT_DEVICETREE = "bcm2835-rpi-a"
UBOOT_ENTRYPOINT = "0x00080000"

require conf/machine/include/rpi-base.inc
require conf/machine/include/obmc-bsp-common.inc
```

## obmc/meta-abc/meta-plat_rpi4b/meta-prj_pmc/conf/machine/prj_rpi4b_pmc.conf
```bitbake
KERNEL_DEVICETREE = "broadcom/bcm2711-rpi-4-b.dtb"

UBOOT_MACHINE = "rpi_4_defconfig"
#UBOOT_DEVICETREE = "bcm2835-rpi-a"
UBOOT_ENTRYPOINT = "0x00080000"

require conf/machine/include/rpi-base.inc
require conf/machine/include/obmc-bsp-common.inc

IMAGE_CLASSES:append = " scp-images"

OBMC_POWER_SUPPLY_INSTANCES = "1 2 3 4"

#FLASH_ROFS_OFFSET:flash-65536 ?= "17408"
```

## obmc/meta-abc/meta-plat_x86_64/conf/layer.conf
```bitbake
# We have a conf and classes directory, add to BBPATH
BBPATH .= ":${LAYERDIR}"

# We have recipes-* directories, add to BBFILES
BBFILES += "${LAYERDIR}/recipes-*/*/*.bb \
            ${LAYERDIR}/recipes-*/*/*.bbappend"

BBFILE_COLLECTIONS += "plat_x86_64-layer"
BBFILE_PATTERN_plat_x86_64-layer := "^${LAYERDIR}/"
LAYERSERIES_COMPAT_plat_x86_64-layer = "walnascar scarthgap"
```

## obmc/meta-abc/meta-plat_x86_64/conf/machine/include/x86_64-base.inc
```bitbake
DEFAULTTUNE ?= "core2-64"

include conf/machine/include/abc-base.inc
require conf/machine/include/x86/tune-x86-64-v3.inc
#require conf/machine/include/qemu.inc
#require conf/machine/include/x86/qemuboot-x86.inc

SERIAL_CONSOLES ?= "115200;ttyS0"

MACHINE_FEATURES += "x86 pci"

MACHINE_ESSENTIAL_EXTRA_RDEPENDS += "v86d"

FLASH_UBOOT_SPL_SIZE ?= "64"
FLASH_UBOOT_OFFSET ?= "0"
FLASH_MANIFEST_OFFSET ?= "380"
FLASH_MANIFEST_OFFSET:flash-65536 ?= "888"
FLASH_MANIFEST_OFFSET:flash-131072 ?= "888"
FLASH_UBOOT_ENV_OFFSET ?= "384"
FLASH_UBOOT_ENV_OFFSET:flash-65536 ?= "896"
FLASH_UBOOT_ENV_OFFSET:flash-131072 ?= "896"
FLASH_KERNEL_OFFSET ?= "512"
FLASH_KERNEL_OFFSET:flash-65536 ?= "1024"
FLASH_KERNEL_OFFSET:flash-131072 ?= "1024"
FLASH_UBI_OFFSET ?= "${FLASH_KERNEL_OFFSET}" 
FLASH_ROFS_OFFSET ?= "4864"
FLASH_ROFS_OFFSET:flash-65536 ?= "16384"
FLASH_ROFS_OFFSET:flash-131072 ?= "16384"
FLASH_RWFS_OFFSET ?= "28672"
FLASH_RWFS_OFFSET:flash-65536 ?= "43008"
FLASH_RWFS_OFFSET:flash-131072 ?= "98304"
```

## obmc/meta-abc/meta-plat_x86_64/conf/machine/plat_x86_64.conf
```bitbake
#KERNEL_DEVICETREE = "broadcom/bcm2835-rpi-a.dtb"

UBOOT_MACHINE = "qemu-x86_64_defconfig"
#UBOOT_DEVICETREE = "bcm2835-rpi-a"

require conf/machine/include/x86_64-base.inc
require conf/machine/include/obmc-bsp-common.inc
```
